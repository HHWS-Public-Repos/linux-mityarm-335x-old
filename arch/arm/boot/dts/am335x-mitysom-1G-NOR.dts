/*
 * Copyright (C) 2012 Texas Instruments Incorporated - http://www.ti.com/
 *
 * This program is free software; you can redistribute it and/or modify
 * it under the terms of the GNU General Public License version 2 as
 * published by the Free Software Foundation.
 */
/dts-v1/;

#include "am335x-mitysom.dtsi"
#include "am335x-mitysom-1G.dtsi"
#include "am335x-mitysom-NOR.dtsi"

&gpmc {
    nand@0,0 {
        /* Remove the nand placeholder partition */
        /delete-node/ partition@0;
    };
};
